## config/west.yml
```yaml
# This file specifies the build dependencies for Github Action workflows and
# for local build environments. The workspace has four toplevel directories
# containing the user config, modules, zephy and ZMK.
#
# ZMK-Workspace
# ├── config
# ├── modules
# ├── zephyr
# └── zmk
#
# To create a local build environment, clone this repository and then run the
# following commands from its toplevel directory:
#
# $ west init -l config
# $ west update
# $ west zephyr-export
#
---
manifest:
  defaults:
    remote: urob
    revision: v0.1 # Pin everything to v0.1

  remotes:
    - name: urob
      url-base: https://github.com/urob

  projects:
    - name: zmk-helpers
      revision: main
      path: modules/helpers
    - name: zmk-auto-layer
      revision: main
      path: modules/auto-layer
    - name: zmk-tri-state
      revision: main
      path: modules/tri-state
    - name: hotdog_pad
      revision: main
      remote: onnenon
    - name: zmk-config-smallwave
      remote: onnenon
      revision: main
    - name: le-chiffre-stm32-zmk-config
      remote: onnenon
      revision: main

    # ZMK with Zephyr namespaced under /zmk. This requires that ZMK imports
    # Zephyr with a path other than `zephyr` (as in `going-modular`).
    - name: zmk
      path: .
      import:
        name-blocklist:
          - ci-tools
          - hal_altera
          - hal_cypress
          - hal_infineon
          - hal_microchip
          - hal_nxp
          - hal_openisa
          - hal_silabs
          - hal_xtensa
          - hal_st
          - hal_ti
          - loramac-node
          - mcuboot
          - mcumgr
          - net-tools
          - openthread
          - edtt
          - trusted-firmware-m

  self:
    path: config
```
