/* source key position labels */
#include "zmk-helpers/key-labels/36.h"

/* map Corne's extra thumb keys */
#define ZMK_BASE_LAYER(name, LT, RT, LM, RM, LB, RB, LH, RH) \
    ZMK_LAYER(name, LT RT LM RM LB RB &kp LGUI LH RH &smart_mouse)

/* activate bluetooth */
#define CONFIG_WIRELESS

/* source the main keymap */
#include "onnen_base.keymap"

/* use 5-column layout for Zen */
ZMK_APPLY_MATRIX_TRANSFORM(five_column_transform)
